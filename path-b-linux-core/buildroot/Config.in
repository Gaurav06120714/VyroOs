## path-b-linux-core/buildroot/Config.in
```kconfig
menu "Vyro OS Core packages"
    source "$BR2_EXTERNAL_VYRO_PATH/package/libvyro-linux/Config.in"
    source "$BR2_EXTERNAL_VYRO_PATH/package/vyro-compositor/Config.in"
    source "$BR2_EXTERNAL_VYRO_PATH/package/vyro-init/Config.in"
endmenu
```

## path-b-linux-core/buildroot/configs/vyro_x86_64_defconfig
```kconfig
# Vyro OS Core — Buildroot defconfig for x86_64
#
# Minimal kernel + musl + Vyro userland. No X11, no Wayland.

BR2_x86_64=y
BR2_TOOLCHAIN_BUILDROOT_MUSL=y
BR2_TOOLCHAIN_BUILDROOT_CXX=y

# Kernel
BR2_LINUX_KERNEL=y
BR2_LINUX_KERNEL_LATEST_VERSION=y
BR2_LINUX_KERNEL_DEFCONFIG="x86_64"

# DRM / KMS in kernel
BR2_LINUX_KERNEL_NEEDS_HOST_OPENSSL=y

# Filesystem
BR2_TARGET_ROOTFS_EXT2=y
BR2_TARGET_ROOTFS_EXT2_4=y

# Bootloader (GRUB EFI)
BR2_TARGET_GRUB2=y
BR2_TARGET_GRUB2_X86_64_EFI=y

# Disk image
BR2_PACKAGE_HOST_GENIMAGE=y

# Vyro packages
BR2_PACKAGE_LIBVYRO_LINUX=y
BR2_PACKAGE_VYRO_COMPOSITOR=y
BR2_PACKAGE_VYRO_INIT=y

# Host tools
BR2_PACKAGE_HOST_DOSFSTOOLS=y
BR2_PACKAGE_HOST_MTOOLS=y

# Libdrm for the compositor
BR2_PACKAGE_LIBDRM=y

# Input
BR2_PACKAGE_LIBINPUT=y
BR2_PACKAGE_LIBEVDEV=y
```

## path-b-linux-core/buildroot/package/libvyro-linux/Config.in
```kconfig
config BR2_PACKAGE_LIBVYRO_LINUX
    bool "libvyro-linux"
    depends on BR2_TOOLCHAIN_HAS_THREADS
    select BR2_PACKAGE_LIBDRM
    select BR2_PACKAGE_LIBINPUT
    help
      The Vyro userland support library, ported to Linux.

      Provides the same window/draw/input/IPC API as the microkernel
      libvyro, implemented over Linux DRM/KMS, evdev, and musl/glibc
      syscalls. Required by every Vyro desktop application.

      https://github.com/Gaurav06120714/VyroOs
```

## path-b-linux-core/buildroot/package/vyro-compositor/Config.in
```kconfig
config BR2_PACKAGE_VYRO_COMPOSITOR
    bool "vyro-compositor"
    select BR2_PACKAGE_LIBDRM
    select BR2_PACKAGE_LIBVYRO_LINUX
    help
      The Vyro display server + window manager.

      Opens /dev/dri/card0 directly, drives mode-setting, allocates dumb
      buffers, composites window pixels, and dispatches input events from
      libinput. No X11, no Wayland.

      https://github.com/Gaurav06120714/VyroOs
```

## path-b-linux-core/buildroot/package/vyro-init/Config.in
```kconfig
config BR2_PACKAGE_VYRO_INIT
    bool "vyro-init"
    help
      Vyro PID 1 — minimal service supervisor for Path B.

      Mounts /proc, /sys, /dev, /run, /tmp; starts udev for device nodes;
      reaps zombies; launches vyro-compositor as the foreground service.

      Not a systemd replacement for general Linux use — just enough to
      bring up the Vyro desktop.

      https://github.com/Gaurav06120714/VyroOs
```
